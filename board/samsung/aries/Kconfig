## board/samsung/aries/Kconfig
```kconfig
if TARGET_ARIES

config SYS_BOARD
	default "aries"

config SYS_VENDOR
	default "samsung"

config SYS_CONFIG_NAME
	default "exynos3_aries"

endif
```

## board/samsung/galaxys4g/Kconfig
```kconfig
if TARGET_S5P_GALAXYS4G

config SYS_BOARD
	default "galaxys4g"

config SYS_VENDOR
	default "samsung"

config SYS_SOC
	default "s5pc1xx"

config SYS_CONFIG_NAME
	default "s5p_galaxys4g"

endif
```

## configs/exynos3_aries_defconfig
```kconfig
CONFIG_ARM=y
# CONFIG_SYS_ARM_MMU is not set
# CONFIG_SPL_USE_ARCH_MEMCPY is not set
CONFIG_ARCH_EXYNOS=y
CONFIG_SYS_TEXT_BASE=0x32000000
CONFIG_ARCH_EXYNOS3=y
CONFIG_TARGET_ARIES=y
CONFIG_ENV_VARS_UBOOT_CONFIG=y
CONFIG_NR_DRAM_BANKS=3
CONFIG_BOOTDELAY=0
CONFIG_USE_BOOTCOMMAND=y
CONFIG_BOOTCOMMAND="run bootcmd;"
CONFIG_MISC_INIT_R=y
CONFIG_HUSH_PARSER=y
# CONFIG_AUTO_COMPLETE is not set
CONFIG_SYS_PROMPT="Aries # "
CONFIG_AUTOBOOT_KEYED=y
CONFIG_AUTOBOOT_DELAY_STR="delay"
CONFIG_AUTOBOOT_STOP_STR="stop"
CONFIG_AUTOBOOT_KEYED_CTRLC=y
CONFIG_CMD_BOOTMENU=y
# CONFIG_CMD_XIMG is not set
CONFIG_CMD_THOR_DOWNLOAD=y
CONFIG_CMD_DFU=y
# CONFIG_CMD_FLASH is not set
CONFIG_CMD_GPIO=y
CONFIG_CMD_GPT=y
CONFIG_CMD_MMC=y
CONFIG_CMD_ONENAND=y
CONFIG_CMD_USB_MASS_STORAGE=y
# CONFIG_CMD_SETEXPR is not set
CONFIG_CMD_CACHE=y
CONFIG_CMD_EXT4=y
CONFIG_CMD_EXT4_WRITE=y
CONFIG_CMD_FAT=y
CONFIG_CMD_FS_GENERIC=y
CONFIG_MTDIDS_DEFAULT="onenand0=b0600000.onenand"
CONFIG_CMD_UBI=y
CONFIG_OF_LIST="s5pc1xx-aries s5pc1xx-fascinate4g s5pc1xx-galaxys"
CONFIG_MULTI_DTB_FIT=y
CONFIG_ENV_IS_IN_ONENAND=y
CONFIG_ENV_VARS_UBOOT_RUNTIME_CONFIG=y
# CONFIG_NET is not set
CONFIG_DFU_MMC=y
CONFIG_USB_FUNCTION_FASTBOOT=y
CONFIG_FASTBOOT_BUF_ADDR=0x40000000
CONFIG_FASTBOOT_BUF_SIZE=0x10000000
CONFIG_FASTBOOT_FLASH=y
CONFIG_FASTBOOT_FLASH_ONENAND=y
CONFIG_FASTBOOT_FLASH_UBI=y
CONFIG_DM_I2C_GPIO=y
CONFIG_GPIO_KEYS=y
CONFIG_MMC_SDHCI=y
CONFIG_MMC_SDHCI_S5P=y
CONFIG_MTD=y
CONFIG_MTD_DEVICE=y
CONFIG_DM_PMIC=y
# CONFIG_SPL_PMIC_CHILDREN is not set
CONFIG_DM_PMIC_MAX8998=y
# CONFIG_SPL_SERIAL_PRESENT is not set
CONFIG_SOFT_SPI=y
CONFIG_USB=y
CONFIG_USB_GADGET=y
CONFIG_USB_GADGET_MANUFACTURER="Samsung"
CONFIG_USB_GADGET_VENDOR_NUM=0x18d1
CONFIG_USB_GADGET_PRODUCT_NUM=0x4e20
CONFIG_USB_GADGET_DWC2_OTG=y
CONFIG_USB_FUNCTION_THOR=y
CONFIG_DM_VIDEO=y
CONFIG_SAMSUNG_S6E63M0=y
CONFIG_USE_TINY_PRINTF=y
# CONFIG_OF_LIBFDT is not set
```

## configs/s5p_aries_defconfig
```kconfig
CONFIG_ARM=y
# CONFIG_SPL_USE_ARCH_MEMCPY is not set
CONFIG_ARCH_S5PC1XX=y
CONFIG_SPL_LDSCRIPT="board/samsung/common/exynos-uboot-spl.lds"
CONFIG_SYS_TEXT_BASE=0x32000000
CONFIG_TARGET_S5P_ARIES=y
CONFIG_SPL=y
CONFIG_ENV_VARS_UBOOT_CONFIG=y
CONFIG_NR_DRAM_BANKS=3
CONFIG_BOOTDELAY=0
CONFIG_USE_BOOTCOMMAND=y
CONFIG_BOOTCOMMAND="run bootcmd;"
CONFIG_MISC_INIT_R=y
# CONFIG_SPL_FRAMEWORK is not set
# CONFIG_SPL_RAW_IMAGE_SUPPORT is not set
# CONFIG_SPL_LEGACY_IMAGE_SUPPORT is not set
CONFIG_SPL_ONENAND_SUPPORT=y
CONFIG_SYS_ONENAND_U_BOOT_OFFS=0x1200000
CONFIG_SYS_ONENAND_PAGE_SIZE=4096
CONFIG_HUSH_PARSER=y
# CONFIG_AUTO_COMPLETE is not set
CONFIG_SYS_PROMPT="Aries # "
CONFIG_AUTOBOOT_KEYED=y
CONFIG_AUTOBOOT_DELAY_STR="delay"
CONFIG_AUTOBOOT_STOP_STR="stop"
CONFIG_AUTOBOOT_KEYED_CTRLC=y
CONFIG_CMD_BOOTMENU=y
# CONFIG_CMD_XIMG is not set
CONFIG_CMD_THOR_DOWNLOAD=y
CONFIG_CMD_DFU=y
# CONFIG_CMD_FLASH is not set
CONFIG_CMD_GPIO=y
CONFIG_CMD_GPT=y
CONFIG_CMD_MMC=y
CONFIG_CMD_ONENAND=y
CONFIG_CMD_USB_MASS_STORAGE=y
# CONFIG_CMD_SETEXPR is not set
CONFIG_CMD_CACHE=y
CONFIG_CMD_EXT4=y
CONFIG_CMD_EXT4_WRITE=y
CONFIG_CMD_FAT=y
CONFIG_CMD_FS_GENERIC=y
CONFIG_MTDIDS_DEFAULT="onenand0=b0600000.onenand"
CONFIG_CMD_UBI=y
# CONFIG_SPL_DOS_PARTITION is not set
# CONFIG_SPL_EFI_PARTITION is not set
CONFIG_DEFAULT_DEVICE_TREE="s5pc1xx-aries"
CONFIG_OF_LIST="s5pc1xx-aries s5pc1xx-fascinate4g s5pc1xx-galaxys"
CONFIG_MULTI_DTB_FIT=y
CONFIG_ENV_IS_IN_ONENAND=y
CONFIG_ENV_VARS_UBOOT_RUNTIME_CONFIG=y
# CONFIG_NET is not set
CONFIG_DFU_MMC=y
CONFIG_USB_FUNCTION_FASTBOOT=y
CONFIG_FASTBOOT_BUF_ADDR=0x40000000
CONFIG_FASTBOOT_BUF_SIZE=0x10000000
CONFIG_FASTBOOT_FLASH=y
CONFIG_FASTBOOT_FLASH_ONENAND=y
CONFIG_FASTBOOT_FLASH_UBI=y
CONFIG_DM_I2C_GPIO=y
CONFIG_DM_KEYBOARD=y
CONFIG_GPIO_KEYS=y
CONFIG_MMC_SDHCI=y
CONFIG_MMC_SDHCI_S5P=y
CONFIG_MTD=y
CONFIG_MTD_DEVICE=y
CONFIG_DM_PMIC=y
# CONFIG_SPL_PMIC_CHILDREN is not set
CONFIG_DM_PMIC_MAX8998=y
# CONFIG_SPL_SERIAL_PRESENT is not set
CONFIG_SPI=y
CONFIG_DM_SPI=y
CONFIG_SOFT_SPI=y
CONFIG_USB=y
CONFIG_USB_GADGET=y
CONFIG_USB_GADGET_MANUFACTURER="Samsung"
CONFIG_USB_GADGET_VENDOR_NUM=0x18d1
CONFIG_USB_GADGET_PRODUCT_NUM=0x4e20
CONFIG_USB_GADGET_DWC2_OTG=y
CONFIG_USB_FUNCTION_THOR=y
CONFIG_DM_VIDEO=y
CONFIG_SYS_WHITE_ON_BLACK=y
CONFIG_SAMSUNG_S6E63M0=y
CONFIG_FAT_WRITE=y
CONFIG_USE_TINY_PRINTF=y
```

## drivers/power/battery/Kconfig
```kconfig
config DM_BATTERY
	bool "Enable Driver Model for BATTERY drivers (UCLASS_BATTERY)"
	depends on DM
	---help---
	This config enables driver model battery support.

config DM_BATTERY_MAX17040
	bool "MAX17040 battery/fuelgauge driver"
	depends on DM_BATTERY
	---help---
	Enable support for the max17040 and max77836 fuelgauge
```

## drivers/power/charger/Kconfig
```kconfig
config DM_CHARGER
	bool "Enable Driver Model for charger drivers (UCLASS_CHARGER)"
	depends on DM
	---help---
	This config enables driver model charger support.

config DM_CHARGER_MAX8998
	bool "Enable charger support for max8998 PMIC"
	depends on DM_CHARGER
	depends on DM_PMIC_MAX8998
	depends on PMIC_CHILDREN
```
